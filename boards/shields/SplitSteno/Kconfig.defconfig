## boards/shields/SplitSteno/Kconfig.defconfig
```kconfig
if SHIELD_MY_KEYBOARD_LEFT

CONFIG_ZMK_BATTERY_REPORTING=y
# Name must be less than 16 characters long!
config ZMK_KEYBOARD_NAME
    default "SplitSteno"

config ZMK_SPLIT_ROLE_CENTRAL
    default y

endif

if SHIELD_MY_KEYBOARD_LEFT || SHIELD_MY_KEYBOARD_RIGHT

config ZMK_SPLIT
    default y

endif
```
